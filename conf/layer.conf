## conf/layer.conf
```bitbake
BBPATH .= ":${LAYERDIR}"

BBFILES += " \
    ${LAYERDIR}/recipes-*/*/*.bb \
    ${LAYERDIR}/recipes-*/*/*.bbappend \
"

# Test images
BBFILES += " \
    ${LAYERDIR}/images/*.bb \
"

BBFILE_COLLECTIONS += "clementine-layer"
BBFILE_PATTERN_clementine-layer := "^${LAYERDIR}/"

BBFILE_PRIORITY_clementine-layer = "10"

LAYERVERSION_clementine-layer = "1"

LAYERDEPENDS_clementine-layer = "core"
LAYERDEPENDS_clementine-layer += "openembedded-layer"
LAYERDEPENDS_clementine-layer += "qt5-layer"

LAYERSERIES_COMPAT_clementine-layer = "gatesgarth hardknott"
```
